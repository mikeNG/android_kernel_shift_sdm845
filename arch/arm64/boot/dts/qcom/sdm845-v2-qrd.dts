// SPDX-License-Identifier: GPL-2.0-only
/*
 * Copyright (c) 2017, The Linux Foundation. All rights reserved.
 */

/dts-v1/;

#include "sdm845-v2.dtsi"
#include "sdm845-sde-display.dtsi"
#include "sdm845-qrd.dtsi"

/ {
	model = "Qualcomm Technologies, Inc. SDM845 V2 QRD";
	compatible = "qcom,sdm845-qrd", "qcom,sdm845", "qcom,qrd";
	qcom,board-id = <11 0>;
};
